## Documentation/devicetree/bindings/arm/mediatek/mediatek,fhctl.yaml
```yaml
# SPDX-License-Identifier: (GPL-2.0 OR BSD-2-Clause)
%YAML 1.2
---
$id: http://devicetree.org/schemas/arm/mediatek/mediatek,fhctl.yaml#
$schema: http://devicetree.org/meta-schemas/core.yaml#

title: MediaTek frequency hopping and spread spectrum clocking control

maintainers:
  - Edward-JW Yang <edward-jw.yang@mediatek.com>

description: |
  Frequency hopping control (FHCTL) is a piece of hardware that control
  some PLLs to adopt "hopping" mechanism to adjust their frequency.
  Spread spectrum clocking (SSC) is another function provided by this hardware.

properties:
  compatible:
    const: mediatek,mt8186-fhctl

  reg:
    maxItems: 2

patternProperties:
  "^map[0-9]$":
    type: object
    description:
      Represents a group of PLLs controlled by the same domain and method.

    properties:
      domain:
        description: The position of this hardware block in the chip.
        $ref: /schemas/types.yaml#/definitions/string-array

      method:
        description: Determine which method to control this FHCTL hardware.
        $ref: /schemas/types.yaml#/definitions/string-array

    patternProperties:
      "^armpll_(ll|bl)|(cci|main|mm|tvd|m|adsp|mfg|nna|nna2|msdc)pll$":
        type: object
        description:
          A subnode represents one PLL clock. The properties it contains are
          used to determine whether this PLL enable frequency hopping mechanism           and spread spectrum clocking (SSC) control.

        properties:
          fh-id:
            description: The index of the PLL clocks.
            $ref: /schemas/types.yaml#/definitions/uint32

          perms:
            description:
              This is a bit field used to manage the permission of frequency
              hopping function and spread spectrum clocking control.
            $ref: /schemas/types.yaml#/definitions/uint32

          ssc-rate:
            description: The percentage of the spectrum spreading.
            $ref: /schemas/types.yaml#/definitions/uint32
            minimum: 0
            maximum: 8

        required:
          - fh-id
          - perms

    required:
      - domain
      - method

required:
  - compatible
  - reg

additionalProperties: false

examples:
  - |
    #include <dt-bindings/clock/mt8186-clk.h>
    fhctl: fhctl@1000ce00 {
        compatible = "mediatek,mt8186-fhctl";
        reg = <0x1000ce00 0x200>,
              <0x1000c000 0xe00>;
        map0 {
            domain = "top";
            method = "fhctl-ap";

            armpll_ll {
                fh-id = <0>;
                perms = <0x10>;
            };

            armpll_bl {
                fh-id = <1>;
                perms = <0x10>;
            };

            ccipll {
                fh-id = <2>;
                perms = <0x10>;
            };

            mainpll {
                fh-id = <3>;
                perms = <0x1c>;
            };

            mmpll {
                fh-id = <4>;
                perms = <0x1c>;
            };

            tvdpll {
                fh-id = <5>;
                perms = <0x1c>;
            };

            mpll {
                fh-id = <6>;
                perms = <0x10>;
            };

            adsppll {
                fh-id = <7>;
                perms = <0x1c>;
            };

            mfgpll {
                fh-id = <8>;
                perms = <0x1c>;
            };

            nnapll {
                fh-id = <9>;
                perms = <0x1c>;
            };

            nna2pll {
                fh-id = <10>;
                perms = <0x1c>;
            };

            msdcpll {
                fh-id = <11>;
                perms = <0x1c>;
                ssc-rate = <3>;
            };
        };
    };
```

## Documentation/devicetree/bindings/media/mediatek,vcodec-encoder-core.yaml
```yaml
# SPDX-License-Identifier: (GPL-2.0-only OR BSD-2-Clause)

%YAML 1.2
---
$id: "http://devicetree.org/schemas/media/mediatek,vcodec-encoder-core.yaml#"
$schema: "http://devicetree.org/meta-schemas/core.yaml#"

title: Mediatek Video Encoder Accelerator With Multi Core

maintainers:
  - Irui Wang <irui.wang@mediatek.com>

description: |
  Mediatek Video Encode is the video encode hardware present in Mediatek
  SoCs which supports high resolution encoding functionalities. Required
  parent and child device node.

properties:
  compatible:
    const: mediatek,mt8195-vcodec-enc

  mediatek,scp:
    $ref: /schemas/types.yaml#/definitions/phandle
    maxItems: 1
    description: |
      The node of system control processor (SCP), using
      the remoteproc & rpmsg framework.

  iommus:
    minItems: 1
    maxItems: 32
    description: |
      List of the hardware port in respective IOMMU block for current Socs.
      Refer to bindings/iommu/mediatek,iommu.yaml.

  dma-ranges:
    maxItems: 1
    description: |
      Describes the physical address space of IOMMU maps to memory.

  "#address-cells":
    const: 1

  "#size-cells":
    const: 1

  ranges: true

# Required child node:
patternProperties:
  "venc_core0@1a020000":
    type: object

    properties:
      compatible:
        const: mediatek,mtk-venc-core0

      reg:
        maxItems: 1

      iommus:
        minItems: 1
        maxItems: 32
        description: |
          List of the hardware port in respective IOMMU block for current Socs.
          Refer to bindings/iommu/mediatek,iommu.yaml.

      interrupts:
        maxItems: 1

      clocks:
        maxItems: 1

      clock-names:
        items:
          - const: MT_CG_VENC0

      assigned-clocks:
        maxItems: 1

      assigned-clock-parents:
        maxItems: 1

      power-domains:
        maxItems: 1

    required:
      - compatible
      - reg
      - iommus
      - interrupts
      - clocks
      - clock-names
      - assigned-clocks
      - assigned-clock-parents
      - power-domains

    additionalProperties: false

  "venc_core1@1b020000":
    type: object

    properties:
      compatible:
        const: mediatek,mtk-venc-core1

      reg:
        maxItems: 1

      iommus:
        minItems: 1
        maxItems: 32
        description: |
          List of the hardware port in respective IOMMU block for current Socs.
          Refer to bindings/iommu/mediatek,iommu.yaml.

      interrupts:
        maxItems: 1

      clocks:
        maxItems: 1

      clock-names:
        items:
          - const: MT_CG_VENC1

      assigned-clocks:
        maxItems: 1

      assigned-clock-parents:
        maxItems: 1

      power-domains:
        maxItems: 1

    required:
      - compatible
      - reg
      - iommus
      - interrupts
      - clocks
      - clock-names
      - assigned-clocks
      - assigned-clock-parents
      - power-domains

    additionalProperties: false

required:
  - compatible
  - mediatek,scp
  - iommus
  - dma-ranges
  - ranges

additionalProperties: false

examples:
  - |
    #include <dt-bindings/interrupt-controller/arm-gic.h>
    #include <dt-bindings/memory/mt8195-memory-port.h>
    #include <dt-bindings/interrupt-controller/irq.h>
    #include <dt-bindings/clock/mt8195-clk.h>
    #include <dt-bindings/power/mt8195-power.h>

    venc {
        compatible = "mediatek,mt8195-vcodec-enc";
        mediatek,scp = <&scp>;
        iommus = <&iommu_vdo M4U_PORT_L19_VENC_RCPU>;
        dma-ranges = <0x1 0x0 0x0 0x40000000 0x0 0xfff00000>;
        #address-cells = <1>;
        #size-cells = <1>;
        ranges;

        venc_core0@1a020000 {
            compatible = "mediatek,mtk-venc-core0";
            reg = <0x1a020000 0x10000>;
            iommus = <&iommu_vdo M4U_PORT_L19_VENC_RCPU>,
                     <&iommu_vdo M4U_PORT_L19_VENC_REC>,
                     <&iommu_vdo M4U_PORT_L19_VENC_BSDMA>,
                     <&iommu_vdo M4U_PORT_L19_VENC_SV_COMV>,
                     <&iommu_vdo M4U_PORT_L19_VENC_RD_COMV>,
                     <&iommu_vdo M4U_PORT_L19_VENC_CUR_LUMA>,
                     <&iommu_vdo M4U_PORT_L19_VENC_CUR_CHROMA>,
                     <&iommu_vdo M4U_PORT_L19_VENC_REF_LUMA>,
                     <&iommu_vdo M4U_PORT_L19_VENC_REF_CHROMA>;
            interrupts = <GIC_SPI 341 IRQ_TYPE_LEVEL_HIGH 0>;
            clocks = <&vencsys CLK_VENC_VENC>;
            clock-names = "MT_CG_VENC0";
            assigned-clocks = <&topckgen CLK_TOP_VENC>;
            assigned-clock-parents = <&topckgen CLK_TOP_UNIVPLL_D4>;
            power-domains = <&spm MT8195_POWER_DOMAIN_VENC>;
        };

        venc_core1@1b020000 {
            compatible = "mediatek,mtk-venc-core1";
            reg = <0x1b020000 0x10000>;
            iommus = <&iommu_vpp M4U_PORT_L20_VENC_RCPU>,
                     <&iommu_vpp M4U_PORT_L20_VENC_REC>,
                     <&iommu_vpp M4U_PORT_L20_VENC_BSDMA>,
                     <&iommu_vpp M4U_PORT_L20_VENC_SV_COMV>,
                     <&iommu_vpp M4U_PORT_L20_VENC_RD_COMV>,
                     <&iommu_vpp M4U_PORT_L20_VENC_CUR_LUMA>,
                     <&iommu_vpp M4U_PORT_L20_VENC_CUR_CHROMA>,
                     <&iommu_vpp M4U_PORT_L20_VENC_REF_LUMA>,
                     <&iommu_vpp M4U_PORT_L20_VENC_REF_CHROMA>;
            interrupts = <GIC_SPI 346 IRQ_TYPE_LEVEL_HIGH 0>;
            clocks = <&vencsys_core1 CLK_VENC_CORE1_VENC>;
            clock-names = "MT_CG_VENC1";
            assigned-clocks = <&topckgen CLK_TOP_VENC>;
            assigned-clock-parents = <&topckgen CLK_TOP_UNIVPLL_D4>;
            power-domains = <&spm MT8195_POWER_DOMAIN_VENC_CORE1>;
        };
    };
```

## Documentation/devicetree/bindings/soc/mediatek/dvfsrc.yaml
```yaml
# SPDX-License-Identifier: (GPL-2.0 OR BSD-2-Clause)
%YAML 1.2
---
$id: "http://devicetree.org/schemas/soc/mediatek/dvfsrc.yaml#"
$schema: "http://devicetree.org/meta-schemas/core.yaml#"

title: MediaTek dynamic voltage and frequency scaling resource collector (DVFSRC)

description: |
  The Dynamic Voltage and Frequency Scaling Resource Collector (DVFSRC) is a
  HW module which is used to collect all the requests from both software and
  hardware and turn into the decision of minimum operating voltage and minimum
  DRAM frequency to fulfill those requests.

maintainers:
  - henryc.chen <henryc.chen@mediatek.com>

properties:
  reg:
    maxItems: 1
    description: DVFSRC common register address and length.

  compatible:
    enum:
      - mediatek,mt6873-dvfsrc
      - mediatek,mt8183-dvfsrc
      - mediatek,mt8192-dvfsrc

  '#interconnect-cells':
    const: 1

  dvfsrc-vcore:
    type: object
    description:
      The DVFSRC regulator is modelled as a subdevice of the DVFSRC.
      Because DVFSRC can request power directly via register read/write, likes
      vcore which is a core power of mt8183. As such, the DVFSRC regulator
      requires that DVFSRC nodes be present.
    $ref: /schemas/regulator/regulator.yaml#

required:
  - compatible
  - reg
  - "#interconnect-cells"

additionalProperties: false

examples:
  - |
    #include <dt-bindings/interconnect/mtk,mt8183-emi.h>

    soc {
        #address-cells = <2>;
        #size-cells = <2>;

        dvfsrc@10012000 {
            compatible = "mediatek,mt8183-dvfsrc";
            reg = <0 0x10012000 0 0x1000>;
            #interconnect-cells = <1>;
            dvfsrc_vcore: dvfsrc-vcore {
                    regulator-name = "dvfsrc-vcore";
                    regulator-min-microvolt = <725000>;
                    regulator-max-microvolt = <800000>;
                    regulator-always-on;
            };
        };
    };
```

## Documentation/devicetree/bindings/sound/mt8195-mt6359.yaml
```yaml
# SPDX-License-Identifier: (GPL-2.0-only OR BSD-2-Clause)
%YAML 1.2
---
$id: http://devicetree.org/schemas/sound/mt8195-mt6359.yaml#
$schema: http://devicetree.org/meta-schemas/core.yaml#

title: MediaTek MT8195 ASoC sound card driver

maintainers:
  - Trevor Wu <trevor.wu@mediatek.com>

description:
  This binding describes the MT8195 sound card.

properties:
  compatible:
    enum:
      - mediatek,mt8195_mt6359_rt1019_rt5682
      - mediatek,mt8195_mt6359_rt1011_rt5682
      - mediatek,mt8195_mt6359_max98390_rt5682

  model:
    $ref: /schemas/types.yaml#/definitions/string
    description: User specified audio sound card name

  mediatek,platform:
    $ref: "/schemas/types.yaml#/definitions/phandle"
    description: The phandle of MT8195 ASoC platform.

  headset-codec:
    type: object
    additionalProperties: false
    properties:
      sound-dai:
        maxItems: 1
    required:
      - sound-dai

  playback-codecs:
    type: object
    additionalProperties: false
    properties:
      sound-dai:
        minItems: 2
        maxItems: 4
    required:
      - sound-dai

  mediatek,adsp:
    $ref: "/schemas/types.yaml#/definitions/phandle"
    description: The phandle of MT8195 ADSP platform.

  mediatek,dai-link:
    $ref: /schemas/types.yaml#/definitions/string-array
    description:
      A list of the desired dai-links in the sound card. Each entry is a
      name defined in the machine driver.

additionalProperties: false

required:
  - compatible
  - mediatek,platform
  - headset-codec
  - playback-codecs

examples:
  - |

    sound: mt8195-sound {
        compatible = "mediatek,mt8195_mt6359_rt1019_rt5682";
        mediatek,platform = <&afe>;
        pinctrl-names = "default";
        pinctrl-0 = <&aud_pins_default>;

        headset-codec {
            sound-dai = <&rt5682>;
        };

        playback-codecs {
             sound-dai = <&dp_tx>, <&hdmi0>, <&rt1019p>;
        };
    };

...
```

## Documentation/devicetree/bindings/thermal/mediatek,mt8192-lvts.yaml
```yaml
# SPDX-License-Identifier: (GPL-2.0-only OR BSD-2-Clause)
%YAML 1.2
---
$id: http://devicetree.org/schemas/thermal/mediatek,mt8192-lvts.yaml#
$schema: http://devicetree.org/meta-schemas/core.yaml#

title: MediaTek SoC LVTS thermal controller

maintainers:
  - Yu-Chia Chang <ethan.chang@mediatek.com>
  - Ben Tseng <ben.tseng@mediatek.com>

allOf:
  - $ref: thermal-sensor.yaml#
  - $ref: /nvmem/nvmem-consumer.yaml#

properties:
  compatible:
    enum:
      - mediatek,mt8192-lvts
      - mediatek,mt8195-lvts

  reg:
    minItems: 2
    maxItems: 4

  interrupts:
    maxItems: 2

  clocks:
    maxItems: 1

  "#thermal-sensor-cells":
    const: 1

  nvmem-cells:
    maxItems: 2
    description: Calibration data for thermal sensors

  nvmem-cell-names:
    items:
      - const: e_data1
      - const: e_data2

  resets:
    $ref: /schemas/types.yaml#/definitions/phandle-array


required:
  - '#thermal-sensor-cells'
  - compatible
  - reg
  - interrupts
  - clocks
  - nvmem-cells
  - nvmem-cell-names
  - resets

additionalProperties: false

examples:
  - |
    #include <dt-bindings/thermal/thermal.h>
    #include <dt-bindings/interrupt-controller/arm-gic.h>
    #include <dt-bindings/clock/mt8195-clk.h>
    #include <dt-bindings/reset/mt8195-resets.h>

    lvts: lvts@1100b000 {
        compatible = "mediatek,mt8195-lvts";
        #thermal-sensor-cells = <1>;
        reg = <0 0x1100b000 0 0x1000>,
              <0 0x11278000 0 0x1000>;
        interrupts = <GIC_SPI 169 IRQ_TYPE_LEVEL_HIGH 0>,
                     <GIC_SPI 170 IRQ_TYPE_LEVEL_HIGH 0>;
        clocks = <&infracfg_ao CLK_INFRA_AO_THERM>;
        resets = <&infracfg_ao MT8195_INFRA_RST0_THERM_CTRL_SWRST>,
                 <&infracfg_ao MT8195_INFRA_RST4_THERM_CTRL_MCU_SWRST>;
        nvmem-cells = <&lvts_e_data1 &lvts_e_data2>;
        nvmem-cell-names = "e_data1","e_data2";
    };
...
```
