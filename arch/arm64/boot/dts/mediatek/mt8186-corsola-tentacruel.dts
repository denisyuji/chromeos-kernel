// SPDX-License-Identifier: (GPL-2.0 OR MIT)
/*
 * Copyright 2022 Google LLC
 */

/dts-v1/;
#include "mt8186-corsola-krabby.dtsi"

/ {
	model = "Google Tentacruel board";
	compatible = "google,tentacruel", "google,corsola", "mediatek,mt8186";
};
